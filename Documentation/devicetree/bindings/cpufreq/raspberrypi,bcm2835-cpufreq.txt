## Documentation/devicetree/bindings/cpufreq/raspberrypi,bcm2835-cpufreq.txt
```
Raspberry Pi Broadcom BCM2835 CPU frequency control

Required properties:

- compatible : should be "raspberrypi,bcm2835-cpufreq"
- firmware : the Raspberry Pi firmware node

Example:

cpufreq {
        compatible = "raspberrypi,bcm2835-cpufreq";
        firmware = <&firmware>;
};
```

## Documentation/devicetree/bindings/input/touchscreen/raspberrypi-ft5406.txt
```
Raspberry Pi 7" Touch Screen Display

Raspberry Pi uses a FT5406 attached to the VideoCore's I2C bus. The firmware
runs a thread that periodicaly does a register dump to a shared memory window.
The interrupt and wake signals seem disconnected.

Required properties:
 - compatible: "raspberrypi,raspberrypi-ft5406"
 - reg: address range of the shared memory with register dump

Example:

        touchscreen: rpi-ft5406@3e40ea40 {
                compatible = "raspberrypi,raspberrypi-ft5406";
                reg = <0x3e40ea40 63>;
        };
```

## Documentation/devicetree/bindings/thermal/brcm,bcm2835-thermal.txt
```
Broadcom BCM2835 thermal control

Required properties:

- compatible : should be "brcm,bcm2835-thermal"
- mbox-names : names of the mailbox channel
- mboxes : mailbox channel to use

Example:

thermal {
	compatible = "brcm,bcm2835-thermal";
	mbox-names = "property";
	mboxes = <&mailbox 8>;
};
```

## Documentation/devicetree/bindings/usb/usb-device.txt
```
Generic USB Device Properties

Usually, we only use device tree for hard wired USB device.
The reference binding doc is from:
http://www.firmware.org/1275/bindings/usb/usb-1_0.ps

Required properties:
- compatible: usbVID,PID
- reg: the port number which this device is connecting to, the range
  is 1-31.


Example:

&usb1 {
	status = "okay";

	#address-cells = <1>;
	#size-cells = <0>;

	hub: genesys@1 {
		compatible = "usb05e3,0608";
		reg = <0x1>;
	};
}
```

## drivers/staging/vc04_services/Kconfig
```kconfig
config BCM2835_VCHIQ
	tristate "Videocore VCHIQ"
	depends on ARCH_BCM2835 && BCM2835_MBOX
	default y
	help
		Kernel to VideoCore communication interface for the
		BCM2835 family of products.
		Defaults to Y when the Broadcom Videocore services
		are included in the build, N otherwise.
```
